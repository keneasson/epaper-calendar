## apps/ble-idf-test/sdkconfig.defaults
```kconfig
# Enable Bluetooth
CONFIG_BT_ENABLED=y
CONFIG_BT_NIMBLE_ENABLED=y

# NimBLE settings
CONFIG_BT_NIMBLE_MAX_CONNECTIONS=3
CONFIG_BT_NIMBLE_MAX_BONDS=3
CONFIG_BT_NIMBLE_PINNED_TO_CORE=0

# Security - completely disabled for testing
CONFIG_BT_NIMBLE_SM_LEGACY=n
CONFIG_BT_NIMBLE_SM_SC=n
CONFIG_BT_NIMBLE_SECURITY_ENABLE=n

# Role configuration
CONFIG_BT_NIMBLE_ROLE_PERIPHERAL=y
CONFIG_BT_NIMBLE_ROLE_CENTRAL=n
CONFIG_BT_NIMBLE_ROLE_BROADCASTER=y
CONFIG_BT_NIMBLE_ROLE_OBSERVER=n

# GAP settings
CONFIG_BT_NIMBLE_GAP_DEVICE_NAME_MAX_LEN=31

# ATT settings - increase MTU
CONFIG_BT_NIMBLE_ATT_PREFERRED_MTU=256

# Log level
CONFIG_LOG_DEFAULT_LEVEL_INFO=y
CONFIG_LOG_MAXIMUM_LEVEL_DEBUG=y
CONFIG_BT_NIMBLE_DEBUG=y

# BLE Controller debug
CONFIG_BT_LE_CONTROLLER_LOG_ENABLED=y
CONFIG_BT_LE_LOG_LEVEL_DEBUG=y

# USB Serial JTAG for ESP32-C6 console output
CONFIG_ESP_CONSOLE_USB_SERIAL_JTAG=y
CONFIG_ESP_CONSOLE_SECONDARY_NONE=y
```
